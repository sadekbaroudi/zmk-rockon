## boards/shields/rockon/Kconfig.defconfig
```kconfig
# Copyright (c) 2021 The ZMK Contributors
# SPDX-License-Identifier: MIT

if SHIELD_ROCKON

config ZMK_KEYBOARD_NAME
    default "rockon"

endif
```

## config/boards/shields/rockon/Kconfig.defconfig
```kconfig
# Copyright (c) 2021 The ZMK Contributors
# SPDX-License-Identifier: MIT

if SHIELD_ROCKON

config ZMK_KEYBOARD_NAME
    default "rockon"

CONFIG_BUILD_OUTPUT_UF2=y

endif
```
